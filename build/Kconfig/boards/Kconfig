## build/Kconfig/boards/Kconfig
```kconfig
# Load Zephyr board Kconfig descriptions.
osource "C:/ncs/v3.2.2/zephyr/boards/qorvo/decawave_dwm3001cdk/Kconfig"
```

## build/zephyr-dw3001cdk-tdoa/Kconfig/boards/Kconfig.decawave_dwm3001cdk
```kconfig
# Load board Kconfig descriptions.
osource "C:/ncs/v3.2.2/zephyr/boards/qorvo/decawave_dwm3001cdk/Kconfig.decawave_dwm3001cdk"
```

## build/zephyr-dw3001cdk-tdoa/Kconfig/boards/Kconfig.defconfig
```kconfig
# Load Zephyr board defconfig descriptions.
osource "C:/ncs/v3.2.2/zephyr/boards/qorvo/decawave_dwm3001cdk/Kconfig.defconfig"
```

## build_1/Kconfig/boards/Kconfig.defconfig
```kconfig
# Load Zephyr board defconfig descriptions.
osource "/home/lakshya/ncs/v3.1.0/zephyr/boards/qorvo/decawave_dwm3001cdk/Kconfig.defconfig"
```

## build_1/zephyr-dw3001cdk-tdoa/Kconfig/arch/Kconfig
```kconfig
# Load Zephyr Arch Kconfig descriptions.
osource "/home/lakshya/ncs/v3.1.0/zephyr/arch/rx/Kconfig"
osource "/home/lakshya/ncs/v3.1.0/zephyr/arch/x86/Kconfig"
osource "/home/lakshya/ncs/v3.1.0/zephyr/arch/xtensa/Kconfig"
osource "/home/lakshya/ncs/v3.1.0/zephyr/arch/sparc/Kconfig"
osource "/home/lakshya/ncs/v3.1.0/zephyr/arch/riscv/Kconfig"
osource "/home/lakshya/ncs/v3.1.0/zephyr/arch/posix/Kconfig"
osource "/home/lakshya/ncs/v3.1.0/zephyr/arch/mips/Kconfig"
osource "/home/lakshya/ncs/v3.1.0/zephyr/arch/arm64/Kconfig"
osource "/home/lakshya/ncs/v3.1.0/zephyr/arch/arm/Kconfig"
osource "/home/lakshya/ncs/v3.1.0/zephyr/arch/arc/Kconfig"
```
